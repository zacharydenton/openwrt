## target/linux/grx500/experimental/nand/Kconfig.nand
```kconfig
config MTD_NAND_GRX500_CALIBRATION
	bool "Read-only AX3000 GRX500 calibration NAND"
	depends on INTEL_MIPS
	default y
	select MTD
	select MTD_BLOCK_RO
	select MTD_RAW_NAND
	select MTD_NAND_ECC_SW_BCH
```

## target/linux/grx500/experimental/pcie/Kconfig.pcie
```kconfig
config PCIE_GRX500
	bool "Intel GRX500 PCIe host"
	depends on INTEL_MIPS && PCI
	default y
	select GPIOLIB
	select GENERIC_PHY
	select RESET_CONTROLLER

config GPIO_GRX500
	bool
	default y if PCIE_GRX500

config RESET_GRX500
	bool
	default y if PCIE_GRX500

config PHY_GRX500_PCIE
	bool
	default y if PCIE_GRX500
```

## target/linux/grx500/experimental/usb/Kconfig.usb
```kconfig
config USB_DWC3_GRX500
	bool "Intel GRX500 DWC3 host integration"
	depends on INTEL_MIPS && USB_DWC3=y
	select PHY_GRX500_USB
	select MFD_SYSCON
	help
	  GRX500 host clock and AXI endian integration for the DWC3 core.

config PHY_GRX500_USB
	bool "Intel GRX500 USB PHY"
	depends on INTEL_MIPS && OF && GPIOLIB && RESET_CONTROLLER
	select GENERIC_PHY
	select MFD_SYSCON
	help
	  GRX500 USB PHY reset, VBUS power and hardware overcurrent recovery.
```

## target/linux/grx500/files/arch/mips/intel-mips/Kconfig.ethernet
```kconfig
# SPDX-License-Identifier: GPL-2.0-only
# Native GRX500 switch, DMA and Ethernet support.

if INTEL_MIPS

config LTQ_ETHSW_API
	bool
	default y

config LTQ_CBM
	bool
	default y

config GRX500_CBM
	bool
	default y

config LTQ_TMU
	bool
	default y

config INTEL_DATAPATH
	bool
	default y

config INTEL_DATAPATH_HAL_GSWIP30
	bool
	default y

config INTEL_DATAPATH_HAL_GSWIP30_MIB
	bool
	default y

config INTEL_DATAPATH_MANUAL_PARSE
	bool
	default y

config INTEL_HDMA
	bool
	default y

config XRX500_PHY_FW
	bool
	default y

config LTQ_ETH_XRX500
	bool
	default y

config CBM_STD_BUF_POOL_SIZE
	hex
	default 0x1200000

config CBM_JBO_BUF_SIZE
	hex
	default 0x800000

config CBM_JBO_PKT_SIZE
	hex
	default 0x4000

config SOC_GRX500
	bool
	default y

config GRX500_NETWORK_EXPERIMENT
	bool
	default y
	select HAVE_PCI
	select PCI_DRIVERS_GENERIC
	select WIRELESS_EXT
	select WEXT_PRIV
	select CRYPTO_CMAC
	select SYSTEM_DATA_VERIFICATION

config GRX500_ETH_PHY_EXPERIMENT
	bool
	default y
	select PHYLIB
	select MDIO_BUS
	select OF_MDIO

endif
```

## target/linux/grx500/files/arch/mips/intel-mips/Kconfig.nand
```kconfig
config MTD_NAND_GRX500
	bool "AX3000 GRX500 NAND with BCH4 ECC"
	depends on INTEL_MIPS
	default y
	select MTD
	select MTD_BLOCK_RO
	select MTD_RAW_NAND
	select MTD_NAND_ECC_SW_BCH

config GRX500_FACTORY_TRIAL
	bool "Experimental AX3000 stock-web trial bank commitment"
	depends on MTD_NAND_GRX500
	default n
	help
	  Permit writes to the two redundant boot-environment partitions for
	  the guarded first-boot bank transaction. Bootloader, calibration and
	  other factory partitions remain read-only. Hardware validation pending.
```
